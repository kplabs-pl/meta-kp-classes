## conf/layer.conf
```bitbake
# We have a conf and classes directory, add to BBPATH
BBPATH .= ":${LAYERDIR}"

BBFILE_COLLECTIONS += "meta-kp-classes"
BBFILE_PATTERN_meta-kp-classes = "^${LAYERDIR}/"
BBFILE_PRIORITY_meta-kp-classes = "6"

LAYERDEPENDS_meta-kp-classes = "core"
LAYERSERIES_COMPAT_meta-kp-classes = "nanbield"

KP_XLNX_SCRIPTS_DIR = "${LAYERDIR}/scripts/"
```

## meta-kp-classes/conf/distro/kplabs-dpu.conf
```bitbake
DISTRO_NAME = "KP Labs DPU"
DISTRO_VERSION = "1.0"
DISTRO_FEATURES="acl debuginfod ext2 ipv4 ipv6 usbhost xattr pci vfat seccomp systemd usrmerge gobject-introspection-data ldconfig"

SDK_NAME = "yocto_sdk_${SDK_OS}"
TOOLCHAIN_OUTPUTNAME="${MACHINE}-${SDK_NAME}"

INIT_MANAGER = "systemd"

GLIBC_GENERATE_LOCALES = "en_US.UTF-8"

# apply no suffix to tmp build directory
TCLIBCAPPEND := ""
```
