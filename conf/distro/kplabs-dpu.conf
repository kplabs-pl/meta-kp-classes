## conf/distro/kplabs-dpu.conf
```bitbake
DISTRO_DESCRIPTION ?= ""
DISTRO_NAME = "${@'KP Labs DPU' if d.getVar('DISTRO_DESCRIPTION') == '' else 'KP Labs DPU ' +  d.getVar('DISTRO_DESCRIPTION')}"
DISTRO_VERSION := "${@'build-' + bb.process.run('git rev-parse HEAD || echo unknown')[0].strip()[:7]}"
DISTRO_FEATURES="acl debuginfod ext2 ipv4 ipv6 usbhost xattr pci vfat seccomp systemd usrmerge gobject-introspection-data ldconfig"

SDK_NAME = "yocto_sdk_${SDK_OS}"
SDK_VERSION = "${DISTRO_VERSION}"
TOOLCHAIN_OUTPUTNAME="${MACHINE}-${SDK_NAME}"

INIT_MANAGER = "systemd"
DISTRO_CODENAME = "KP Labs DPU"
GLIBC_GENERATE_LOCALES = "en_US.UTF-8 en_GB.UTF-8 C.UTF-8"

# apply no suffix to tmp build directory
TCLIBCAPPEND := ""
```
